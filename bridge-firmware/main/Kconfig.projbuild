## bridge-firmware/main/Kconfig.projbuild
```kconfig
menu "PTLabel Bridge"

config BRIDGE_WIFI_SSID
    string "WiFi SSID"
    default "changeme"

config BRIDGE_WIFI_PASSWORD
    string "WiFi password"
    default "changeme"

config BRIDGE_LED_GPIO
    int "LED GPIO"
    default 48
    range 0 48

config BRIDGE_LOG_UDP_PORT
    int "UDP log broadcast port"
    default 5514

config BRIDGE_USB_AUTOSTART
    bool "Start USB host at boot (else require POST /usb/enable)"
    default n
    help
        When disabled, the native USB-C port remains a USB-Serial-JTAG console
        until POST /usb/enable is called. Keep disabled for development so the
        serial console survives across reboots.

endmenu
```

## buildroot-external/Config.in
```kconfig
config BR2_PTLABEL_KERNEL_6_6_HEADERS
	bool
	default y
	select BR2_TOOLCHAIN_HEADERS_AT_LEAST_6_6
	depends on BR2_LINUX_KERNEL
	depends on BR2_LINUX_KERNEL_CUSTOM_GIT
	depends on BR2_KERNEL_HEADERS_AS_KERNEL

menu "PTLabel packages"

source "$BR2_EXTERNAL_PTLABEL_PATH/package/ptlabel-bridge/Config.in"

endmenu
```

## buildroot-external/package/ptlabel-bridge/Config.in
```kconfig
config BR2_PACKAGE_PTLABEL_BRIDGE
	bool "ptlabel-bridge"
	depends on BR2_arm
	select BR2_PACKAGE_LIBUSB
	help
	  PTLabel USB bridge service for Brother P-Touch printing.
```
